## drivers/soc/sunxi/Kconfig
```kconfig
# SPDX-License-Identifier: GPL-2.0-only
#
# Allwinner sunXi SoC drivers
#

config SUNXI_MBUS
	bool "Allwinner sunxi-mbus"
	default y
	depends on NET_VENDOR_ALLWINNER
	help
	  Say y to enable the fixups needed to support the Allwinner
	  MBUS DMA quirks.

config SUNXI_SRAM
	bool "Allwinner sunxi-sram"
	depends on NET_VENDOR_ALLWINNER
	default y
	select REGMAP_MMIO
	help
	  Say y here to enable the SRAM controller support. This
	  device is responsible on mapping the SRAM in the sunXi SoCs
	  whether to the CPU/DMA, or to the devices.
```
